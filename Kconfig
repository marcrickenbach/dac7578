## drivers/dac/Kconfig
```kconfig
# DAC7875 Octal DAC configuration options

#
# Copyright (c) 2024 FKMG Circuits
#

menuconfig DAC7578
	bool "DAC7578 Octal DAC"
	depends on I2C
	depends on DAC
	help
	  Enable the driver for the TI DAC7578.

config DAC7578_INIT_PRIORITY
    int "Initialization priority for TI DAC7578"
    default 80
    depends on DAC7578
    help
      Set the initialization priority for the TI DAC7578 driver.
```
